// ESP8266+Tasker Remote Timer

#include <Arduino.h>
#include <Wire.h>
#include <U8g2lib.h>
#include <ESP8266WiFi.h>
#include <ESP8266HTTPClient.h>
#include <WiFiManager.h>
#include <NTPClient.h>
#include <EasyButton.h>
#include <WiFiUdp.h>
#include <TimeLib.h>

#define NTP_ADDR "pool.ntp.org"

#define ENCODER_1 D5
#define ENCODER_2 D6
#define ENCODER_BTN D7

#define send_width 27
#define send_height 26
static unsigned char send_bits[] = {
   0xff, 0xff, 0xff, 0x07, 0x01, 0x00, 0x00, 0x04, 0x01, 0x00, 0x00, 0x04,
   0x01, 0x00, 0x00, 0x04, 0x01, 0x00, 0x00, 0x04, 0x01, 0x00, 0x00, 0x04,
   0x01, 0x00, 0x00, 0x04, 0x01, 0x00, 0x00, 0x04, 0x39, 0x00, 0x00, 0x05,
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   0x01, 0x00, 0x00, 0x04, 0xff, 0xff, 0xff, 0x07 };

#define send_selected_width 27
#define send_selected_height 26
static unsigned char send_selected_bits[] = {
   0xff, 0xff, 0xff, 0x07, 0xff, 0xff, 0xff, 0x07, 0xff, 0xff, 0xff, 0x07,
   0xff, 0xff, 0xff, 0x07, 0xff, 0xff, 0xff, 0x07, 0xff, 0xff, 0xff, 0x07,
   0xff, 0xff, 0xff, 0x07, 0xff, 0xff, 0xff, 0x07, 0xc7, 0xff, 0xff, 0x06,
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   0xff, 0xff, 0xff, 0x07, 0xff, 0xff, 0xff, 0x07 };

#define reset_width 29
#define reset_height 26
static unsigned char reset_bits[] = {
   0xff, 0xff, 0xff, 0x1f, 0x01, 0x00, 0x00, 0x10, 0x01, 0x00, 0x00, 0x10,
   0x3d, 0x00, 0x00, 0x10, 0x45, 0x00, 0x00, 0x10, 0x45, 0x00, 0x00, 0x12,
   0x45, 0x8e, 0x73, 0x16, 0x3d, 0x51, 0x88, 0x12, 0x25, 0x9f, 0xf9, 0x12,
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   0x01, 0x00, 0x00, 0x10, 0xff, 0xff, 0xff, 0x1f };

#define reset_selected_width 29
#define reset_selected_height 26
static unsigned char reset_selected_bits[] = {
   0xff, 0xff, 0xff, 0x1f, 0xff, 0xff, 0xff, 0x1f, 0xff, 0xff, 0xff, 0x1f,
   0xc3, 0xff, 0xff, 0x1f, 0xbb, 0xff, 0xff, 0x1f, 0xbb, 0xff, 0xff, 0x1d,
   0xbb, 0x71, 0x8c, 0x19, 0xc3, 0xae, 0x77, 0x1d, 0xdb, 0x60, 0x06, 0x1d,
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   0xff, 0xff, 0xff, 0x1f, 0xff, 0xff, 0xff, 0x1f };

#define colon_width 4
#define colon_height 28
static unsigned char colon_bits[] = {
   0x00, 0x00, 0x00, 0x00, 0x00, 0x00, 0x00, 0x06, 0x0f, 0x0f, 0x06, 0x00,
   0x00, 0x00, 0x00, 0x00, 0x00, 0x06, 0x0f, 0x0f, 0x06, 0x00, 0x00, 0x00,
   0x00, 0x00, 0x00, 0x00 };

#define connected_width 124
#define connected_height 28
static unsigned char connected_bits[] = {
   0x00, 0x00, 0x00, 0x00, 0x00, 0x00, 0x00, 0x00, 0x00, 0x00, 0x00, 0x00,
   0x00, 0x00, 0x00, 0x00, 0x00, 0x00, 0x00, 0x00, 0x00, 0x00, 0x00, 0x00,
   0x00, 0x00, 0x00, 0x00, 0x00, 0x00, 0x00, 0x00, 0x00, 0x00, 0x00, 0x00,
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   0x00, 0x00, 0x00, 0x00 };

#define connecting_width 124
#define connecting_height 28
static unsigned char connecting_bits[] = {
   0x00, 0x00, 0x00, 0x00, 0x00, 0x00, 0x00, 0x00, 0x00, 0x00, 0x00, 0x00,
   0x00, 0x00, 0x00, 0x00, 0x00, 0x00, 0x00, 0x00, 0x00, 0x00, 0x00, 0x00,
   0x00, 0x00, 0x00, 0x00, 0x00, 0x00, 0x00, 0x00, 0x00, 0x00, 0x00, 0x00,
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   0x00, 0x00, 0x00, 0x00 };

#define sent_width 124
#define sent_height 28
static unsigned char sent_bits[] = {
   0x00, 0x00, 0x00, 0x00, 0x00, 0x00, 0x00, 0x00, 0x00, 0x00, 0x00, 0x00,
   0x00, 0x00, 0x00, 0x00, 0x00, 0x00, 0x00, 0x00, 0x00, 0x00, 0x00, 0x00,
   0x00, 0x00, 0x00, 0x00, 0x00, 0x00, 0x00, 0x00, 0x00, 0x00, 0x00, 0x00,
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   0x00, 0x00, 0x00, 0x00 };

#define sending_width 124
#define sending_height 28
static unsigned char sending_bits[] = {
   0x00, 0x00, 0x00, 0x00, 0x00, 0x00, 0x00, 0x00, 0x00, 0x00, 0x00, 0x00,
   0x00, 0x00, 0x00, 0x00, 0x00, 0x00, 0x00, 0x00, 0x00, 0x00, 0x00, 0x00,
   0x00, 0x00, 0x00, 0x00, 0x00, 0x00, 0x00, 0x00, 0x00, 0x00, 0x00, 0x00,
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   0x00, 0x00, 0x00, 0x00 };

#define num_width 14
#define num_height 20
static unsigned char zero_bits[] = {
   0x00, 0x00, 0x00, 0x00, 0xe0, 0x01, 0xf0, 0x03, 0x18, 0x06, 0x18, 0x06,
   0x0c, 0x0c, 0x0c, 0x0c, 0x0c, 0x0c, 0x0c, 0x0c, 0x0c, 0x0c, 0x0c, 0x0c,
   0x0c, 0x0c, 0x0c, 0x0c, 0x18, 0x06, 0x18, 0x06, 0xf0, 0x03, 0xe0, 0x01,
   0x00, 0x00, 0x00, 0x00 };

static unsigned char one_bits[] = {
   0x00, 0x00, 0x00, 0x00, 0x80, 0x01, 0x80, 0x01, 0xc0, 0x01, 0xf0, 0x01,
   0xb8, 0x01, 0x88, 0x01, 0x80, 0x01, 0x80, 0x01, 0x80, 0x01, 0x80, 0x01,
   0x80, 0x01, 0x80, 0x01, 0x80, 0x01, 0x80, 0x01, 0x80, 0x01, 0x80, 0x01,
   0x00, 0x00, 0x00, 0x00 };

static unsigned char two_bits[] = {
   0x00, 0x00, 0x00, 0x00, 0xf0, 0x03, 0xf8, 0x07, 0x1c, 0x0e, 0x0c, 0x0c,
   0x00, 0x0c, 0x00, 0x0c, 0x00, 0x0c, 0x00, 0x06, 0x00, 0x03, 0x80, 0x01,
   0xc0, 0x00, 0x60, 0x00, 0x30, 0x00, 0x18, 0x00, 0xfc, 0x0f, 0xfc, 0x0f,
   0x00, 0x00, 0x00, 0x00 };

static unsigned char three_bits[] = {
   0x00, 0x00, 0x00, 0x00, 0xf0, 0x01, 0xf8, 0x03, 0x1c, 0x07, 0x0c, 0x06,
   0x00, 0x06, 0x00, 0x03, 0xc0, 0x01, 0xc0, 0x03, 0x00, 0x06, 0x00, 0x0c,
   0x00, 0x0c, 0x00, 0x0c, 0x0c, 0x0c, 0x1c, 0x06, 0xf8, 0x07, 0xf0, 0x01,
   0x00, 0x00, 0x00, 0x00 };

static unsigned char four_bits[] = {
   0x00, 0x00, 0x00, 0x00, 0x00, 0x03, 0x80, 0x03, 0xc0, 0x03, 0xc0, 0x03,
   0x60, 0x03, 0x60, 0x03, 0x30, 0x03, 0x38, 0x03, 0x18, 0x03, 0x0c, 0x03,
   0xfc, 0x0f, 0xfc, 0x0f, 0x00, 0x03, 0x00, 0x03, 0x00, 0x03, 0x00, 0x03,
   0x00, 0x00, 0x00, 0x00 };

static unsigned char five_bits[] = {
   0x00, 0x00, 0x00, 0x00, 0xf0, 0x07, 0xf0, 0x07, 0x18, 0x00, 0x18, 0x00,
   0x18, 0x00, 0xf8, 0x01, 0xfc, 0x07, 0x0c, 0x06, 0x00, 0x0c, 0x00, 0x0c,
   0x00, 0x0c, 0x00, 0x0c, 0x0c, 0x0c, 0x1c, 0x06, 0xf8, 0x07, 0xf0, 0x01,
   0x00, 0x00, 0x00, 0x00 };

static unsigned char six_bits[] = {
   0x00, 0x00, 0x00, 0x00, 0xe0, 0x03, 0xf0, 0x07, 0x18, 0x0e, 0x18, 0x0c,
   0x0c, 0x00, 0x0c, 0x00, 0xcc, 0x03, 0xfc, 0x07, 0x1c, 0x0e, 0x0c, 0x0c,
   0x0c, 0x0c, 0x0c, 0x0c, 0x0c, 0x0c, 0x18, 0x06, 0xf8, 0x07, 0xe0, 0x01,
   0x00, 0x00, 0x00, 0x00 };

static unsigned char seven_bits[] = {
   0x00, 0x00, 0x00, 0x00, 0xfc, 0x0f, 0xfc, 0x0f, 0x00, 0x04, 0x00, 0x06,
   0x00, 0x03, 0x80, 0x01, 0x80, 0x01, 0xc0, 0x00, 0xc0, 0x00, 0x60, 0x00,
   0x60, 0x00, 0x60, 0x00, 0x20, 0x00, 0x30, 0x00, 0x30, 0x00, 0x30, 0x00,
   0x00, 0x00, 0x00, 0x00 };

static unsigned char eight_bits[] = {
   0x00, 0x00, 0x00, 0x00, 0xe0, 0x01, 0xf0, 0x03, 0x18, 0x06, 0x18, 0x06,
   0x18, 0x06, 0x18, 0x06, 0xf0, 0x03, 0xf0, 0x03, 0x18, 0x06, 0x0c, 0x0c,
   0x0c, 0x0c, 0x0c, 0x0c, 0x0c, 0x0c, 0x18, 0x06, 0xf8, 0x07, 0xe0, 0x01,
   0x00, 0x00, 0x00, 0x00 };

static unsigned char nine_bits[] = {
   0x00, 0x00, 0x00, 0x00, 0xe0, 0x01, 0xf8, 0x03, 0x18, 0x06, 0x0c, 0x04,
   0x0c, 0x0c, 0x0c, 0x0c, 0x0c, 0x0c, 0x18, 0x0e, 0xf8, 0x0f, 0xf0, 0x0c,
   0x00, 0x0c, 0x00, 0x0c, 0x0c, 0x06, 0x1c, 0x07, 0xf8, 0x03, 0xf0, 0x01,
   0x00, 0x00, 0x00, 0x00 };

const char *requestAddress = "http://autoremotejoaomgcd.appspot.com/sendmessage";
const char *key = ""; // removed - add your own

const byte encoderType = 0;
const int THRESH =(4-(2*encoderType));
const byte ZEERO = 0x80;

volatile int currentValue = 0;
int oldValue = 0;
long hourVal = 0;
long minVal = 0;
long unixOffset;
byte CURRENT;
byte INDEX = 15;
byte TOTAL = 0;
bool timeLimit = true;
int upperLimit = 23;
int httpCode;
int ENCTABLE[]  = {0,1,-1,0,-1,0,0,1,1,0,0,-1,0,-1,1,0};
bool isButtonPressed = false;
bool firstStageComplete = false;
bool secondStageComplete = false;
int currentMenuItem = 0;
int digit1 = 0;
int digit2 = 0;
int digit3 = 0;
int digit4 = 0;

U8G2_SSD1306_128X32_UNIVISION_F_HW_I2C u8g2(U8G2_R0);
WiFiUDP ntpUDP;
NTPClient timeClient(ntpUDP, NTP_ADDR);
WiFiManager WiFiMgmt;
EasyButton encoderBTN(13);

void setAlarm() {
  timeClient.update();
  unixOffset = minVal + hourVal;
  long currentTime = timeClient.getEpochTime() + unixOffset;
  setTime(currentTime);
  HTTPClient http;
  http.begin(requestAddress);
  http.addHeader("Content-Type", "application/x-www-form-urlencoded");
  while(httpCode != 200) {
    httpCode = http.POST("key=" + String(key) + "&message==:=" + hour() + "=:=" + minute());
  }
  Serial.print(String(httpCode));
  String payload = http.getString();
  Serial.println(" " + payload);
  http.end();
}

void menuPre() {
  u8g2.clearBuffer();
  u8g2.drawFrame(0, 0, 128, 32);
  u8g2.drawFrame(1, 1, 126, 30);
}

void ICACHE_RAM_ATTR Encoder() {
  INDEX = INDEX << 2;
  if(digitalRead (ENCODER_1)) bitSet(INDEX,0);
  if(digitalRead (ENCODER_2)) bitSet(INDEX,1);
  CURRENT = INDEX & 3;
  INDEX &= 15;

  TOTAL += ENCTABLE[INDEX];

  if((CURRENT == 3) || ((CURRENT == 0) && encoderType)) {

    if(TOTAL == (ZEERO + THRESH)) {
      if(timeLimit == true && currentValue != upperLimit) {
        currentValue++;
      } else if(timeLimit == false) {
        currentValue++;
      }
    }

    else if(TOTAL == (ZEERO - THRESH)) {
      if(timeLimit == true && currentValue != 0) {
        currentValue--;
      } else if(timeLimit == false) {
        currentValue--;
      }
    }
    TOTAL = ZEERO;
  }
}

void menuPost() {
  u8g2.sendBuffer();
}

void drawNum(int posx, int posy, int num) {
  switch(num) {
    case 0:
      u8g2.drawXBM(posx, posy, num_width, num_height, zero_bits);
      break;
    case 1:
      u8g2.drawXBM(posx, posy, num_width, num_height, one_bits);
      break;
    case 2:
      u8g2.drawXBM(posx, posy, num_width, num_height, two_bits);
      break;
    case 3:
      u8g2.drawXBM(posx, posy, num_width, num_height, three_bits);
      break;
    case 4:
      u8g2.drawXBM(posx, posy, num_width, num_height, four_bits);
      break;
    case 5:
      u8g2.drawXBM(posx, posy, num_width, num_height, five_bits);
      break;
    case 6:
      u8g2.drawXBM(posx, posy, num_width, num_height, six_bits);
      break;
    case 7:
      u8g2.drawXBM(posx, posy, num_width, num_height, seven_bits);
      break;
    case 8:
      u8g2.drawXBM(posx, posy, num_width, num_height, eight_bits);
      break;
    case 9:
      u8g2.drawXBM(posx, posy, num_width, num_height, nine_bits);
  }
}

void drawMenu() {
  switch(currentMenuItem) {
    case 1:
      menuPre();
      drawNum(4, 6, digit1);
      drawNum(19, 6, digit2);
      drawNum(39, 6, digit3);
      drawNum(54, 6, digit4);
      u8g2.drawXBM(34, 2, colon_width, colon_height, colon_bits);
      u8g2.drawXBM(68, 3, send_width, send_height, send_bits);
      u8g2.drawXBM(96, 3, reset_width, reset_height, reset_bits);
      menuPost();
      break;
    case 2:
      menuPre();
      drawNum(4, 6, digit1);
      drawNum(19, 6, digit2);
      drawNum(39, 6, digit3);
      drawNum(54, 6, digit4);
      u8g2.drawXBM(34, 2, colon_width, colon_height, colon_bits);
      u8g2.drawXBM(68, 3, send_selected_width, send_selected_height, send_selected_bits);
      u8g2.drawXBM(96, 3, reset_width, reset_height, reset_bits);
      menuPost();
      break;
    case 3:
      menuPre();
      drawNum(4, 6, digit1);
      drawNum(19, 6, digit2);
      drawNum(39, 6, digit3);
      drawNum(54, 6, digit4);
      u8g2.drawXBM(34, 2, colon_width, colon_height, colon_bits);
      u8g2.drawXBM(68, 3, send_width, send_height, send_bits);
      u8g2.drawXBM(96, 3, reset_selected_width, reset_selected_height, reset_selected_bits);
      menuPost();

    }
}

void encoderPressed() {
  Serial.println("Button pressed");
  if(currentMenuItem == 3) {
    WiFiMgmt.resetSettings();
    WiFi.disconnect();
    ESP.eraseConfig();
    ESP.restart();
  } else {
    isButtonPressed = true; 
  }
}

void ICACHE_RAM_ATTR buttonISR() {
  encoderBTN.read();
}

void initUi() {
  currentMenuItem = 1;
  digit1 = 0;
  digit2 = 0;
  digit3 = 0;
  digit4 = 0;
  drawMenu();
}

void nextMenuItem() {
 currentMenuItem++;
 drawMenu();
}

void previousMenuItem() {
  currentMenuItem--;
  drawMenu();
}

void setup() {
  Serial.begin(9600);
  u8g2.begin();
  encoderBTN.begin();
  encoderBTN.onPressed(encoderPressed);
  if (encoderBTN.supportsInterrupt())
  {
    encoderBTN.enableInterrupt(buttonISR);
  }

  pinMode(ENCODER_1, INPUT_PULLUP);
  pinMode(ENCODER_2, INPUT_PULLUP);

  attachInterrupt(digitalPinToInterrupt(ENCODER_1), Encoder, CHANGE);
  attachInterrupt(digitalPinToInterrupt(ENCODER_2), Encoder, CHANGE);

  Serial.println("Connecting to WiFi");
  menuPre();
  u8g2.drawXBM(2, 2, connecting_width, connecting_height, connecting_bits);
  menuPost();

  WiFiMgmt.autoConnect();
  
  menuPre();
  u8g2.drawXBM(2, 2, connected_width, connected_height, connected_bits);
  menuPost();

  Serial.println("Getting network time");
  timeClient.begin();
  timeClient.setTimeOffset(0);
  timeClient.update();

  delay(200);
  Serial.println("Load complete");
  initUi();
  currentValue = 0;
  oldValue = 0;
}

void loop() {  
  if(firstStageComplete == false) {
    if(currentValue != oldValue) {
      Serial.println("Encoder val: " + String(currentValue));
      if(currentValue % 10 == currentValue) {
        digit1 = 0;
        digit2 = currentValue;
      } else {
        digit2 = currentValue % 10;
        digit1 = (currentValue / 10) % 10;
      }
      oldValue = currentValue;
    }
    
    if (isButtonPressed) {
      isButtonPressed = false;
      hourVal = currentValue * 3600;
      upperLimit = 59;
      currentValue = 0;
      oldValue = 0;
      firstStageComplete = true;
    }
  }

  if(secondStageComplete == false) {
    if(currentValue != oldValue) {
      Serial.println("Encoder val: " + String(currentValue));
      if(currentValue % 10 == currentValue) {
        digit3 = 0;
        digit4 = currentValue;
      } else {
        digit4 = currentValue % 10;
        digit3 = (currentValue / 10) % 10;
      }
      oldValue = currentValue;
    }
    
    if (isButtonPressed) {
      isButtonPressed = false;
      minVal = currentValue * 60;
      currentValue = 0;
      oldValue = 0;
      timeLimit = false;
      secondStageComplete = true;
    }
  } else {
    if(currentValue != oldValue) {
      Serial.println("Encoder val: " + String(currentValue));
      if(currentMenuItem == 2) {
        currentMenuItem = 3;
      } else {
        currentMenuItem = 2;
      }
      oldValue = currentValue;
    } else if(isButtonPressed) {
      isButtonPressed = false;
      menuPre();
      u8g2.drawXBM(2, 2, sending_width, sending_height, sending_bits);
      menuPost();

      setAlarm();
      delay(1000);

      menuPre();
      u8g2.drawXBM(2, 2, sent_width, sent_height, sent_bits);
      menuPost();
      ESP.deepSleep(0);
    }
  }
  drawMenu();
}